## prj.conf
```kconfig
CONFIG_ADC=y
CONFIG_GPIO=y

CONFIG_LOG=n
CONFIG_ADC_LOG_LEVEL_DBG=n
```

## xiao_ble_nrf52840_sense.overlay
```dts
// To get started, press Ctrl+Space to bring up the completion menu and view the available nodes.

// You can also use the buttons in the sidebar to perform actions on nodes.
// Actions currently available include:

// * Enabling / disabling the node
// * Adding the bus to a bus
// * Removing the node
// * Connecting ADC channels

// For more help, browse the DeviceTree documentation at https://docs.zephyrproject.org/latest/guides/dts/index.html
// You can also visit the nRF DeviceTree extension documentation at https://docs.nordicsemi.com/bundle/nrf-connect-vscode/page/guides/ncs_configure_app.html#devicetree-support-in-the-extension
/ {
    vbatt {
    compatible = "voltage-divider";
    label = "Voltage divider";
    io-channels = <&adc 7>;
    output-ohms = <510000>;
    full-ohms =  <1510000>;
    power-gpios = <&gpio0 14 GPIO_ACTIVE_LOW>;
    };
};

/* Konfigurace kanálu 4 na SAADC modulu */
&adc {
   #address-cells = <1>;
   #size-cells = <0>;
 
  channel@7 {
    reg = <7>;
    zephyr,gain = "ADC_GAIN_1_3";
    zephyr,reference = "ADC_REF_INTERNAL";
    zephyr,acquisition-time = <0>;
    zephyr,input-positive = <NRF_SAADC_AIN7>;
    zephyr,resolution = <12>;
    zephyr,oversampling = <8>;
   };
};
```

## src/main.c
```c
/*
 * Copyright (c) 2018-2019 Peter Bigot Consulting, LLC
 * Copyright (c) 2019 Nordic Semiconductor ASA
 *
 * SPDX-License-Identifier: Apache-2.0
 */

#include <math.h>
#include <stdio.h>
#include <stdlib.h>

#include <zephyr/kernel.h>
#include "battery.h"

/** A discharge curve specific to the power source. */
static const struct battery_level_point levels[] = {
	{ 10000, 3950 },
	{ 625, 3550 },
	{ 0, 3100 },
};

static const char *now_str(void) {
	static char buf[16]; /* ...HH:MM:SS.MMM */
	uint32_t now = k_uptime_get_32();
	unsigned int ms = now % MSEC_PER_SEC;
	unsigned int s;
	unsigned int min;
	unsigned int h;

	now /= MSEC_PER_SEC;
	s = now % 60U;
	now /= 60U;
	min = now % 60U;
	now /= 60U;
	h = now;

	snprintf(buf, sizeof(buf), "%u:%02u:%02u.%03u",
		 h, min, s, ms);
	return buf;
}

int main(void)
{
	int rc = battery_measure_enable(true);

	if (rc != 0) {
		printk("Failed initialize battery measurement: %d\n", rc);
		return 0;
	}

	while (true) {
		int batt_mV = battery_sample();

		if (batt_mV < 0) {
			printk("Failed to read battery voltage: %d\n",
			       batt_mV);
			break;
		}

		unsigned int batt_pptt = battery_level_pptt(batt_mV, levels);

		printk("[%s]: %d mV; %u pptt\n", now_str(),
		       batt_mV, batt_pptt);

		/* Burn battery so you can see that this works over time */
		k_busy_wait(5 * USEC_PER_SEC);
	}
	printk("Disable: %d\n", battery_measure_enable(false));
	return 0;
}
```

## CMakeLists.txt
```
#
# Copyright (c) 2021 Nordic Semiconductor
#
# SPDX-License-Identifier: LicenseRef-Nordic-5-Clause
#

cmake_minimum_required(VERSION 3.20.0)

find_package(Zephyr REQUIRED HINTS $ENV{ZEPHYR_BASE})
project(data_forwarderpTX)

# NORDIC SDK APP START
target_sources(app PRIVATE src/main.c)
# NORDIC SDK APP END
```

## prj.conf
```kconfig
#
# Copyright (c) 2021 Nordic Semiconductor ASA
#
# SPDX-License-Identifier: LicenseRef-Nordic-5-Clause
#

#UART is used by data forwarder
CONFIG_STDOUT_CONSOLE=y
CONFIG_UART_CONSOLE=y
CONFIG_SERIAL=y

# Data forwarder uses UART async API
CONFIG_UART_ASYNC_API=y

# Enable simulated sensor
CONFIG_SENSOR=y

# LibC
CONFIG_PICOLIBC_IO_FLOAT=y

#IMU libs
CONFIG_STDOUT_CONSOLE=y
CONFIG_I2C=y
CONFIG_SPI=y
CONFIG_SENSOR=y
CONFIG_CBPRINTF_FP_SUPPORT=y

CONFIG_LOG=y
CONFIG_LSM6DSL_TRIGGER_OWN_THREAD=y

#ESB radio libs
CONFIG_NCS_SAMPLES_DEFAULTS=y
CONFIG_ESB=y
CONFIG_ESB_MAX_PAYLOAD_LENGTH=32
CONFIG_CLOCK_CONTROL=y
```

## src/main.c
```c
#include <zephyr/kernel.h>
#include <stdio.h>
#include <zephyr/drivers/sensor.h>
#include <stdio.h>
#include <stdlib.h>
#include <zephyr/logging/log.h>
#include <zephyr/drivers/clock_control.h>
#include <zephyr/drivers/clock_control/nrf_clock_control.h>

//ESB part
#include <esb.h>
uint8_t addr_prefix[1] = {0xA2};

static const int64_t sampling_freq = 52; // in Hz.
#define LOG_DEBUG_DEF 4

static struct sensor_value accel_xyz_out[3];

K_MSGQ_DEFINE(imu_msgq, sizeof(int32_t) * 3 * 2, 450, 4);

static void lsm6dsl_trigger_handler(const struct device *dev,
				    const struct sensor_trigger *trig);

LOG_MODULE_REGISTER(esb_prx, LOG_DEBUG_DEF);

void event_handler(struct esb_evt const *event);

int esb_initialize(); //init of ESB

#if defined(CONFIG_CLOCK_CONTROL_NRF)

int clocks_start(void)
{
	int err;
	int res;
	struct onoff_manager *clk_mgr;
	struct onoff_client clk_cli;

	clk_mgr = z_nrf_clock_control_get_onoff(CLOCK_CONTROL_NRF_SUBSYS_HF);
	if (!clk_mgr) {
		LOG_ERR("Unable to get the Clock manager");
		return -ENXIO;
	}

	sys_notify_init_spinwait(&clk_cli.notify);

	err = onoff_request(clk_mgr, &clk_cli);
	if (err < 0) {
		LOG_ERR("Clock request failed: %d", err);
		return err;
	}

	do {
		err = sys_notify_fetch_result(&clk_cli.notify, &res);
		if (!err && res) {
			LOG_ERR("Clock could not be started: %d", res);
			return res;
		}
	} while (err);

#if defined(NRF54L15_XXAA)
	/* MLTPAN-20 */
	nrf_clock_task_trigger(NRF_CLOCK, NRF_CLOCK_TASK_PLLSTART);
#endif /* defined(NRF54L15_XXAA) */

	LOG_DBG("HF clock started");
	return 0;
}
#else
BUILD_ASSERT(false, "No Clock Control driver");
#endif /* defined(CONFIG_CLOCK_CONTROL_NRF2) */

int main() {
	int err;
    // output immediately without buffering
    setvbuf(stdout, NULL, _IONBF, 0);

	err = clocks_start();
	if (err) {
		printk("Clock initialization failed, err %d", err);
		return EXIT_FAILURE;
	}

	err = esb_initialize();
	if (err) {
		printk("ESB initialization failed, err %d", err);
		return EXIT_FAILURE;
	}

    // get driver for the accelerometer
	struct sensor_value odr_attr;
	const struct device *lsm6dsl_dev = DEVICE_DT_GET_ONE(st_lsm6dsl);
    if (lsm6dsl_dev == NULL) {
        printf("Could not get lsm6dsl_dev device\n");
        return EXIT_FAILURE;
    }

	/* set accel/gyro sampling frequency to 104 Hz */
	odr_attr.val1 = 52;
	odr_attr.val2 = 0;

	if (sensor_attr_set(lsm6dsl_dev, SENSOR_CHAN_ACCEL_XYZ,
			    SENSOR_ATTR_SAMPLING_FREQUENCY, &odr_attr) < 0) {
		printf("Cannot set sampling frequency for accelerometer.\n");
		return EXIT_FAILURE;
	}

	struct sensor_trigger trig;

	trig.type = SENSOR_TRIG_DATA_READY;
	trig.chan = SENSOR_CHAN_ACCEL_XYZ;

	if (sensor_trigger_set(lsm6dsl_dev, &trig, lsm6dsl_trigger_handler) != 0) {
		printk("Could not set sensor type and channel\n");
	}
	
	struct esb_payload tx = {
        .noack  = true,
        .length = sizeof(float) * 3
    };

	float f_val_buffer[3];
	struct sensor_value acc_buffer[3];
	while (1) {
		k_msgq_get(&imu_msgq, acc_buffer, K_FOREVER);
		if (k_msgq_num_used_get(&imu_msgq) > (150 * 3 / 4)) {
								printk("IMU queue > 75%% full!\n");
		}
		f_val_buffer[0]= sensor_value_to_float(&acc_buffer[0]);
		f_val_buffer[1]= sensor_value_to_float(&acc_buffer[1]);
		f_val_buffer[2]= sensor_value_to_float(&acc_buffer[2]);
		//printk("This are the walues form sensor Ax:%f Ay:%f Az:%f \n",f_val_buffer[0], f_val_buffer[1], f_val_buffer[2]);
		memcpy(tx.data, f_val_buffer, sizeof(f_val_buffer));

		err = esb_write_payload(&tx);
		if (err) {
			printk("esb_write_payload failed, err: %d\n", err);
			err = esb_flush_tx();
			if (err) {
				printk("Flush tx failed, err: %d", err);
			}
		}
    }
	return err;
}

void event_handler(struct esb_evt const *event) {
	switch (event->evt_id) {
		case ESB_EVENT_RX_RECEIVED:
			break;

		case ESB_EVENT_TX_SUCCESS:
			break;

		case ESB_EVENT_TX_FAILED:
			break;
	}
}

int esb_initialize() {
	int err;
	/* These are nonarbitrary default addresses.*/
	uint8_t base_addr_0[4] = {0xF1, 0xF1, 0xF1, 0xF1};

	struct esb_config config = ESB_DEFAULT_CONFIG;

	config.protocol = ESB_PROTOCOL_ESB_DPL;
    config.tx_mode  = ESB_TXMODE_AUTO;
	config.tx_output_power = 8;
	config.bitrate = ESB_BITRATE_1MBPS;
	config.event_handler = event_handler;
	config.mode = ESB_MODE_PTX;
	config.selective_auto_ack = false;


	if (IS_ENABLED(CONFIG_ESB_FAST_SWITCHING)) {
		config.use_fast_ramp_up = true;
	}

	err = esb_init(&config);
	if (err) {
		return err;
	}

	// Set channel to 80 ( that means 2480 MHz)
	err = esb_set_rf_channel(79);
	if (err) {
		printk("Set RF channel failed");
		return err;
	}

	err = esb_set_base_address_0(base_addr_0);
	if (err) {
		return err;
	}

	err = esb_set_prefixes(addr_prefix, ARRAY_SIZE(addr_prefix));
	if (err) {
		return err;
	}

	return err;
}

static void lsm6dsl_trigger_handler(const struct device *dev,
				    const struct sensor_trigger *trig) {

	static struct sensor_value accel_x, accel_y, accel_z;

	sensor_sample_fetch_chan(dev, SENSOR_CHAN_ACCEL_XYZ);
	sensor_channel_get(dev, SENSOR_CHAN_ACCEL_X, &accel_x);
	sensor_channel_get(dev, SENSOR_CHAN_ACCEL_Y, &accel_y);
	sensor_channel_get(dev, SENSOR_CHAN_ACCEL_Z, &accel_z);
	accel_xyz_out[0]=accel_x;
	accel_xyz_out[1]=accel_y;
	accel_xyz_out[2]=accel_z;
	int err = k_msgq_put(&imu_msgq, accel_xyz_out, K_NO_WAIT);
	if(err){
		printk("Couldn t send packet err:%d\n", err);
	}
}
```

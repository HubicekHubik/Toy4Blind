## nRFconnect/ESB_RSSI/esb_ptx/build/Kconfig/boards/Kconfig.defconfig
```kconfig
# Load Zephyr board defconfig descriptions.
osource "C:/ncs/v3.1.1/zephyr/boards/nordic/nrf21540dk/Kconfig.defconfig"
```

## nRFconnect/ESB_RSSI/esb_ptx/build/Kconfig/boards/Kconfig.nrf21540dk
```kconfig
# Load board Kconfig descriptions.
osource "C:/ncs/v3.1.1/zephyr/boards/nordic/nrf21540dk/Kconfig.nrf21540dk"
```

## nRFconnect/ESB_RSSI/esb_ptx/build/Kconfig/boards/Kconfig.sysbuild
```kconfig
# Load Sysbuild board Kconfig descriptions.
osource "C:/ncs/v3.1.1/zephyr/boards/nordic/nrf21540dk/Kconfig.sysbuild"
```

## nRFconnect/ESB_RSSI/esb_ptx/build_1/Kconfig/boards/Kconfig.defconfig
```kconfig
# Load Zephyr board defconfig descriptions.
osource "C:/ncs/v3.1.1/zephyr/boards/seeed/xiao_ble/Kconfig.defconfig"
```

## nRFconnect/ESB_RSSI/esb_ptx/build_1/Kconfig/boards/Kconfig.xiao_ble
```kconfig
# Load board Kconfig descriptions.
osource "C:/ncs/v3.1.1/zephyr/boards/seeed/xiao_ble/Kconfig.xiao_ble"
```

## nRFconnect/Mainprogram/XiaoMyCombo/out/build/${presetName}_1/Kconfig/boards/Kconfig.sysbuild
```kconfig
# Load Sysbuild board Kconfig descriptions.
osource "C:/ncs/v3.0.2/zephyr/boards/seeed/xiao_ble/Kconfig.sysbuild"
```

## nRFconnect/Mainprogram/esb_prxMyCombo/out/build/${presetName}_1/Kconfig/boards/Kconfig.xiao_ble
```kconfig
# Load board Kconfig descriptions.
osource "C:/ncs/v3.0.2/zephyr/boards/seeed/xiao_ble/Kconfig.xiao_ble"
```

## nRFconnect/Mainprogram/esb_prxMyComboZep/out/build/${presetName}/Kconfig/boards/Kconfig.defconfig
```kconfig
# Load Zephyr board defconfig descriptions.
osource "C:/ncs/v3.0.2/zephyr/boards/seeed/xiao_ble/Kconfig.defconfig"
```

## nRFconnect/Mainprogram/esb_prxMyComboZep/xiaog2Zmodulev18/west.yml
```yaml
manifest:

  projects:
    - name: edge-impulse-sdk-zephyr
      description: Edge Impulse SDK for Zephyr
      path: modules/edge-impulse-sdk-zephyr
      revision: v1.79.0
      url: https://github.com/edgeimpulse/edge-impulse-sdk-zephyr
```

## prj.conf
```kconfig
#
# Copyright (c) 2019 Nordic Semiconductor ASA
#
# SPDX-License-Identifier: LicenseRef-Nordic-5-Clause
#
CONFIG_NCS_SAMPLES_DEFAULTS=y
CONFIG_ESB=y
CONFIG_DK_LIBRARY=y
CONFIG_CLOCK_CONTROL=y

# Enable hardware info driver (for reading unique device ID)
CONFIG_HWINFO=y
```

## fem.conf
```kconfig
#FEM Support
CONFIG_MPSL=y
CONFIG_MPSL_FEM=y
CONFIG_MPSL_FEM_NRF21540_GPIO_SPI=y
CONFIG_MPSL_FEM_NRF21540_GPIO=n
CONFIG_MPSL_FEM_NRF21540_RUNTIME_PA_GAIN_CONTROL=y
```

## boards/raytac_an54l15q_db_nrf54l15_cpuapp.conf
```kconfig
#
# Copyright (c) 2025 Nordic Semiconductor
#
# SPDX-License-Identifier: LicenseRef-Nordic-5-Clause
#

# Enable DPPI driver
CONFIG_NRFX_DPPI10=y

# Enable the raytac clock driver
CONFIG_CLOCK_CONTROL_NRF_K32SRC_RC=y
CONFIG_CLOCK_CONTROL_NRF_K32SRC_RC_CALIBRATION=y
CONFIG_CLOCK_CONTROL_NRF_K32SRC_500PPM=y
CONFIG_CLOCK_CONTROL_NRF_K32SRC_XTAL=n
CONFIG_CLOCK_CONTROL_NRF_K32SRC_SYNTH=n

# Start SYSCOUNTER on driver init
CONFIG_NRF_GRTC_START_SYSCOUNTER=y
```

## src/main.c
```c
/*
 * Copyright (c) 2018 Nordic Semiconductor ASA
 *
 * SPDX-License-Identifier: LicenseRef-Nordic-5-Clause
 */
#include <zephyr/drivers/clock_control.h>
#include <zephyr/drivers/clock_control/nrf_clock_control.h>
#if defined(NRF54L15_XXAA)
#include <hal/nrf_clock.h>
#endif /* defined(NRF54L15_XXAA) */
#include <zephyr/drivers/gpio.h>
#include <zephyr/irq.h>
#include <zephyr/logging/log.h>
#include <nrf.h>
#include <esb.h>
#include <zephyr/device.h>
#include <zephyr/devicetree.h>
#include <zephyr/kernel.h>
#include <zephyr/types.h>
#include <dk_buttons_and_leds.h>
#include <zephyr/drivers/hwinfo.h>
#include <zephyr/sys/byteorder.h>
#if defined(CONFIG_CLOCK_CONTROL_NRF2)
#include <hal/nrf_lrcconf.h>
#endif
#include "radio_utils.h"
#include "device_info.h"
#define FLAG_END_OF_TEST 0x01

int err;
int8_t tx_power;
int8_t tx_fem_power;
int8_t min_tx_power;
int8_t max_tx_power;
int8_t base_tx_power; // Base TX Power without FEM
int8_t calculated_tx_power; // FEM TX Power
int8_t fem_tx_power_overwrite; // FEM TX Power
int8_t bitrate;

bool repeatModes;
bool firstRun;
int8_t repeat_tx_power;

// Version Information
static int buildversion=3;
static const char *board_id = "PTX";

void log_and_validate_bitrate(int8_t* bitrate) {
    switch (*bitrate) {
        case ESB_BITRATE_2MBPS:
            printk("Using 2 Mbps bitrate\n");
            break;
        case ESB_BITRATE_1MBPS:
            printk("Using 1 Mbps bitrate\n");
            break;
        default:
            *bitrate = ESB_BITRATE_1MBPS;
            printk("Invalid bitrate, defaulting to 1 Mbps\n");
            break;
    }
}

void set_tx_power_in_payload(struct esb_payload *payload, int8_t dbm) {
	if (payload == NULL || payload->length < 3) {
		// Zorg dat er minstens 3 bytes zijn
		return;
	}
	payload->data[2] = (uint8_t)dbm;
}

LOG_MODULE_REGISTER(esb_ptx, CONFIG_ESB_PTX_APP_LOG_LEVEL);

static bool ready = true;
static struct esb_payload rx_payload;
static struct esb_payload tx_payload = ESB_CREATE_PAYLOAD(0,
	0x01, 0x00, 0x03, 0x04, 0x05, 0x06, 0x07, 0x08, 0x00);

#define _RADIO_SHORTS_COMMON                                                   \
	(RADIO_SHORTS_READY_START_Msk | RADIO_SHORTS_END_DISABLE_Msk |         \
	 RADIO_SHORTS_ADDRESS_RSSISTART_Msk |                                  \
	 RADIO_SHORTS_DISABLED_RSSISTOP_Msk)

void event_handler(struct esb_evt const *event)
{
	ready = true;

	switch (event->evt_id) {
	case ESB_EVENT_TX_SUCCESS:
		printk("Sending: TX SUCCESS\n");
		break;
	case ESB_EVENT_TX_FAILED:
		if (firstRun){
			printk("\nTX failed. Is the PRX running? Check frequency and bitrate.\n\n");
		}
		else{
			printk("Sending: TX FAILED\n");
		}
		break;
	case ESB_EVENT_RX_RECEIVED:
		while (esb_read_rx_payload(&rx_payload) == 0) {
			/*
			LOG_DBG("xxxxPacket received, len %d : "
				"0x%02x, 0x%02x, 0x%02x, 0x%02x, "
				"0x%02x, 0x%02x, 0x%02x, 0x%02x",
				rx_payload.length, rx_payload.data[0],
				rx_payload.data[1], rx_payload.data[2],
				rx_payload.data[3], rx_payload.data[4],
				rx_payload.data[5], rx_payload.data[6],
				rx_payload.data[7]);

			*/
			LOG_DBG("ACK payload received on PTX, len: %d", rx_payload.length);
		}
		break;
	}
}

#if defined(CONFIG_CLOCK_CONTROL_NRF)
int clocks_start(void)
{
	int err;
	int res;
	struct onoff_manager *clk_mgr;
	struct onoff_client clk_cli;

	clk_mgr = z_nrf_clock_control_get_onoff(CLOCK_CONTROL_NRF_SUBSYS_HF);
	if (!clk_mgr) {
		LOG_ERR("Unable to get the Clock manager");
		return -ENXIO;
	}

	sys_notify_init_spinwait(&clk_cli.notify);

	err = onoff_request(clk_mgr, &clk_cli);
	if (err < 0) {
		LOG_ERR("Clock request failed: %d", err);
		return err;
	}

	do {
		err = sys_notify_fetch_result(&clk_cli.notify, &res);
		if (!err && res) {
			LOG_ERR("Clock could not be started: %d", res);
			return res;
		}
	} while (err);

#if defined(NRF54L15_XXAA)
	/* MLTPAN-20 */
	nrf_clock_task_trigger(NRF_CLOCK, NRF_CLOCK_TASK_PLLSTART);
#endif /* defined(NRF54L15_XXAA) */

	printk("HF clock started\n");
	return 0;
}

#elif defined(CONFIG_CLOCK_CONTROL_NRF2)

int clocks_start(void)
{
	int err;
	int res;
	const struct device *radio_clk_dev =
		DEVICE_DT_GET_OR_NULL(DT_CLOCKS_CTLR(DT_NODELABEL(radio)));
	struct onoff_client radio_cli;

	/** Keep radio domain powered all the time to reduce latency. */
	nrf_lrcconf_poweron_force_set(NRF_LRCCONF010, NRF_LRCCONF_POWER_DOMAIN_1, true);

	sys_notify_init_spinwait(&radio_cli.notify);

	err = nrf_clock_control_request(radio_clk_dev, NULL, &radio_cli);

	do {
		err = sys_notify_fetch_result(&radio_cli.notify, &res);
		if (!err && res) {
			LOG_ERR("Clock could not be started: %d", res);
			return res;
		}
	} while (err == -EAGAIN);

	nrf_lrcconf_clock_always_run_force_set(NRF_LRCCONF000, 0, true);
	nrf_lrcconf_task_trigger(NRF_LRCCONF000, NRF_LRCCONF_TASK_CLKSTART_0);

	LOG_DBG("HF clock started");
	return 0;
}

#else
BUILD_ASSERT(false, "No Clock Control driver");
#endif /* defined(CONFIG_CLOCK_CONTROL_NRF2) */

int esb_initialize(void)
{
	int err;
	
	/* These are arbitrary default addresses. In end user products
	 * different addresses should be used for each set of devices.
	 */
	uint8_t base_addr_0[4] = {0xE6, 0xE6, 0xE6, 0xE6};
	uint8_t base_addr_1[4] = {0xC3, 0xC3, 0xC3, 0xC3};
	uint8_t addr_prefix[8] = {0xE7, 0xC2, 0xC3, 0xC4, 0xC5, 0xC6, 0xC7, 0xC8};

	struct esb_config config = ESB_DEFAULT_CONFIG;

	config.protocol = ESB_PROTOCOL_ESB_DPL;
	config.retransmit_delay = 600;
	config.bitrate = bitrate;
	config.event_handler = event_handler;
	config.mode = ESB_MODE_PTX;
	config.selective_auto_ack = true;
	config.tx_output_power = 8;
	if (IS_ENABLED(CONFIG_ESB_FAST_SWITCHING)) {
		config.use_fast_ramp_up = true;
	}

	err = esb_init(&config);

	if (err) {
		return err;
	}

	err = esb_set_base_address_0(base_addr_0);
	if (err) {
		return err;
	}

	err = esb_set_base_address_1(base_addr_1);
	if (err) {
		return err;
	}

	err = esb_set_prefixes(addr_prefix, ARRAY_SIZE(addr_prefix));
	if (err) {
		return err;
	}
	// Set channel to 80 ( that means 2480 MHz)
	err = esb_set_rf_channel(79);
	if (err) {
		LOG_ERR("Set RF channel failed");
		return err;
	}

	return 0;
}

static void leds_update(uint8_t value)
{
	uint32_t leds_mask =
		(!(value % 8 > 0 && value % 8 <= 4) ? DK_LED1_MSK : 0) |
		(!(value % 8 > 1 && value % 8 <= 5) ? DK_LED2_MSK : 0) |
		(!(value % 8 > 2 && value % 8 <= 6) ? DK_LED3_MSK : 0) |
		(!(value % 8 > 3) ? DK_LED4_MSK : 0);

	dk_set_leds(leds_mask);
}

void radio_power_enhance(void)
{
#if defined(NRF_VREQCTRL)
	LOG_INF("\nIncrease Radio TX Power: Enabling VREGRADIO High Voltage Mode\n");
	NRF_VREQCTRL->VREGRADIO.VREQH = 1;
	while(!NRF_VREQCTRL->VREGRADIO.VREQHREADY);	
	LOG_INF("VREQHREADY: %s\n\n", NRF_VREQCTRL->VREGRADIO.VREQHREADY ? "true" : "false");
	LOG_INF("RADIO regulator is now operating at high voltage (1.9V).\n");
#else
	LOG_INF("High voltage radio mode not supported on this device.\n");
#endif
}

int main(void)
{
	// Default TX Power settings
	min_tx_power = 0;   // -40dBm -> 20dBm
	max_tx_power = 8;	// -40dBm -> 20dBm
	fem_tx_power_overwrite = 30; // FEM TX Power overwrite value of ONFIG_MPSL_FEM_NRF21540_TX_GAIN_DB from Kconfig

	bitrate = ESB_BITRATE_1MBPS;  // Default bitrate is 1 Mbps although it can be changed to 2 Mbps

	
	// Set repeat Modes
	repeatModes = true;
	repeat_tx_power = 8;
	
	k_sleep(K_MSEC(1000));
	
	// Application name
	printk("\nEnhanced ShockBurst ptx sample\n");
	printk("TX Performance test and RSSI value\n");
	
	
	// Build information
	printk("\n[%s] Version: %d | Build: %s %s\n", board_id, buildversion, __DATE__, __TIME__);
	printk("Board: %s\n", CONFIG_BOARD);
	
    init_device_info();
    printk("Device ID: %u\n", get_device_id());

	// Set device_id (4 bytes) to data[3..6]
	sys_put_le32(get_device_id(), &tx_payload.data[3]);

	// Set board ID to data[7]
	tx_payload.data[7] = BOARD_ID;

	// Change lengte to: total 9 bytes
	tx_payload.length = 9;

	// Increase Radio TX Power for nRF5340
	#if defined(NRF_VREQCTRL)
		//radio_power_enhance();
	#endif

	printk("Check FEM TX support\n\n");
	// Check FEM Support
	#if defined(CONFIG_MPSL_FEM)
	if (CONFIG_MPSL_FEM)
	{
		printk("FEM TX support\n\n");
		if (CONFIG_MPSL_FEM_NRF21540_TX_GAIN_DB>0) tx_fem_power = CONFIG_MPSL_FEM_NRF21540_TX_GAIN_DB;
		if (fem_tx_power_overwrite>0) 
		{
			tx_fem_power = fem_tx_power_overwrite;
			printk("FEM TX support: enabled (TX gain: %d dBm) - manual overwrite!\n", tx_fem_power);
		}
		else
		{
			printk("FEM TX support: enabled (TX gain: %d dBm)\n", tx_fem_power);
		}
		
		// Overwrite TX Power with FEM TX Power
		repeat_tx_power = tx_fem_power;
	}
	#endif /* defined(CONFIG_MPSL_FEM) */
	if (tx_fem_power==0)
	{
		printk("FEM TX support: disabled\n");
	}

	// Log and validate bitrate
	log_and_validate_bitrate(&bitrate);
		
	if (repeatModes)
	{
		printk("Repeat Modes activate on (TX gain: %d dBm)\n\n", repeat_tx_power);
		tx_power = repeat_tx_power;
		firstRun = true;
	}
	else
	{
		printk("Repeat Modes: not active\n\n");
		tx_power = min_tx_power;
	}

	err = clocks_start();
	if (err) {
		return 0;
	}

	err = dk_leds_init();
	if (err) {
		LOG_ERR("LEDs initialization failed, err %d\n", err);
		return 0;
	}

	err = esb_initialize();
	if (err) {
		LOG_ERR("ESB initialization failed, err %d\n", err);
		return 0;
	}

	printk("Initialization complete\n");
	printk("Sending test packet\n");

	printk("\n----------------------\n\n");	

	k_sleep(K_MSEC(1000));

	tx_payload.noack = false;
	while (1) 
	{
		if (ready) 
		{
			ready = false;
			esb_flush_tx();
			leds_update(tx_payload.data[1]);

			// Power Repeat Test Mode
			if (repeatModes)
			{
				if (firstRun)
				{
					#if defined(CONFIG_BOARD_NRF5340DK) || (CONFIG_BOARD_NRF7002DK)
					{
						if (tx_fem_power==0)
						{
							tx_power = 0; // nRF5340 and nRF7002 do not support TX Power > 0 dBm
							printk("\nRF5340 and nRF7002 do not support TX Power > 0 dBm, set TX Power to 0 dBm\n");
						}
					}
					#endif
										
					esb_set_tx_power(tx_power);
					printk("\nSet TX power to: %d dBm (0x%02X)\n", tx_power, (uint8_t)tx_power);
					set_tx_power_in_payload(&tx_payload, tx_power);
				}

				err = esb_write_payload(&tx_payload);
				if (err) {
					LOG_ERR("Payload write failed, err %d\n", err);
				}

				if (firstRun)
				{
					k_sleep(K_MSEC(10));
					
					base_tx_power = get_current_tx_power_dbm();
					if (tx_fem_power > 0) calculated_tx_power = tx_fem_power - base_tx_power; // Calculate FEM TX Power
					else calculated_tx_power = 0; // No FEM TX Power 	
					printk("Base TX-Power = %d dBm, FEM TX-Power = %d dBm, Totaal TX-Power = %d dBm \n", base_tx_power,calculated_tx_power,base_tx_power+calculated_tx_power);
					
					firstRun= false;
					printk("Repeat modes active\n\n");
				}

				tx_payload.data[1]++;
				tx_payload.data[8] = 0x00; // Geen vlag
				//k_sleep(K_USEC(40));
			}
			
			// Power Range Test Mode
			else
			{
				if (tx_power_supported(tx_power)) 
			{
					// Calculation of TX Power is not always correct!!!!!!!!!!!
					
					esb_set_tx_power(tx_power+tx_fem_power);
					printk("\nSet TX power to: %d dBm (0x%02X)\n", tx_power, (uint8_t)tx_power);
					set_tx_power_in_payload(&tx_payload, tx_power+tx_fem_power);

					err = esb_write_payload(&tx_payload);
					if (err) {
						LOG_ERR("Payload write failed, err %d\n", err);
					}

					tx_payload.data[1]++;
					k_sleep(K_MSEC(10));

					base_tx_power = get_current_tx_power_dbm();
					if (tx_fem_power > 0) calculated_tx_power = tx_fem_power - base_tx_power; // Calculate FEM TX Power
					else calculated_tx_power = 0; // No FEM TX Power 						
					printk("Base TX-Power = %d dBm, FEM TX-Power = %d dBm, Totaal TX-Power = %d dBm \n", base_tx_power,calculated_tx_power,base_tx_power+calculated_tx_power);
				} 
				else 
				{
					printk("\nBase TX power %d dBm is NOT supported.\n", tx_power);
					ready = true;
					k_sleep(K_MSEC(100));
				}

				// set power to new value
				tx_power++;
				
				if (tx_power > max_tx_power)
				{
					tx_payload.data[8] = FLAG_END_OF_TEST;

					err = esb_write_payload(&tx_payload);
					if (err) {
						LOG_ERR("Payload write failed, err %d\n", err);
						}
					k_sleep(K_MSEC(10));				
					printk("\nEnd of test\n\n");
					break;	
				}
				else 
				{
					tx_payload.data[8] = 0x00; // Geen vlag
				}
			}			
			k_sleep(K_MSEC(100));
		}
	}
}
```

## src/device_info.c
```c
#include "device_info.h"
#include <zephyr/drivers/hwinfo.h>
#include <zephyr/sys/byteorder.h>

// Static opslag van het device ID
static uint32_t device_id;

void init_device_info(void)
{
    uint8_t hwid[8];
    if (hwinfo_get_device_id(hwid, sizeof(hwid)) >= 8) {
        device_id = sys_get_le32(&hwid[0]) ^ sys_get_le32(&hwid[4]);
    } else {
        device_id = 0xFFFFFFFF;
    }
}

uint32_t get_device_id(void)
{
    return device_id;
}
```

## src/device_info.h
```c
#ifndef DEVICE_INFO_H
#define DEVICE_INFO_H

#include <stdint.h>

#ifdef __cplusplus
extern "C" {
#endif

void init_device_info(void);
uint32_t get_device_id(void);

/* Defineer board ID hier op basis van config */
#if defined(CONFIG_BOARD_NRF21540DK) && defined(CONFIG_MPSL_FEM)
    #define BOARD_ID 0x11
#elif defined(CONFIG_BOARD_NRF52840DK) && defined(CONFIG_MPSL_FEM)
    #define BOARD_ID 0x12
#elif defined(CONFIG_BOARD_NRF5340DK) && defined(CONFIG_MPSL_FEM)
    #define BOARD_ID 0x13
#elif defined(CONFIG_BOARD_NRF5340_AUDIO_DK) && defined(CONFIG_MPSL_FEM)
    #define BOARD_ID 0x14
#elif defined(CONFIG_BOARD_NRF7002DK) && defined(CONFIG_MPSL_FEM)
    #define BOARD_ID 0x15
#elif defined(CONFIG_BOARD_NRF54L15DK) && defined(CONFIG_MPSL_FEM)
    #define BOARD_ID 0x16

#elif defined(CONFIG_BOARD_NRF21540DK)
    #define BOARD_ID 0x01
#elif defined(CONFIG_BOARD_NRF52840DK)
    #define BOARD_ID 0x02
#elif defined(CONFIG_BOARD_NRF5340DK)
    #define BOARD_ID 0x03
#elif defined(CONFIG_BOARD_NRF5340_AUDIO_DK)
    #define BOARD_ID 0x04
#elif defined(CONFIG_BOARD_NRF7002DK)
    #define BOARD_ID 0x05
#elif defined(CONFIG_BOARD_NRF54L15DK)
    #define BOARD_ID 0x06

#elif defined(CONFIG_BOARD_RAYTAC_MDBT50Q_DB_40_NRF52840)
    #define BOARD_ID 0x21
#elif defined(CONFIG_BOARD_RAYTAC_AN54L15Q_DB)
    #define BOARD_ID 0x22
#else
    #define BOARD_ID 0xFF  // Unknown
#endif

#ifdef __cplusplus
}
#endif

#endif // DEVICE_INFO_H
```

## src/radio_utils.c
```c
#include "radio_utils.h"
#include <hal/nrf_radio.h>

/**
 * @brief Gets the currently active TX power setting from the RADIO peripheral.
 *
 * This function returns the TX power that is currently configured in the RADIO peripheral's TXPOWER register.
 * Note that when using the ESB (Enhanced ShockBurst) protocol, calling esb_set_tx_power() does not
 * immediately update the TXPOWER hardware register. Instead, the desired power level is stored internally
 * in the ESB driver and only applied when a transmission is started (e.g., during esb_write_payload()).
 *
 * Therefore, if this function is called immediately after esb_set_tx_power() and before any payload has been
 * transmitted, it may return the *previous* TX power value. To get the actual active TX power, call this
 * function after at least one successful transmission.
 *
 * @return The current TX power in dBm, as set in the RADIO peripheral.
 */
int8_t get_current_tx_power_dbm(void) {
	nrf_radio_txpower_t raw_power = nrf_radio_txpower_get(NRF_RADIO);

	switch (raw_power) {
#if defined(RADIO_TXPOWER_TXPOWER_Pos8dBm)
	case RADIO_TXPOWER_TXPOWER_Pos8dBm:
		return 8;
#endif
#if defined(RADIO_TXPOWER_TXPOWER_Pos7dBm)
	case RADIO_TXPOWER_TXPOWER_Pos7dBm:
		return 7;
#endif
#if defined(RADIO_TXPOWER_TXPOWER_Pos6dBm)
	case RADIO_TXPOWER_TXPOWER_Pos6dBm:
		return 6;
#endif
#if defined(RADIO_TXPOWER_TXPOWER_Pos5dBm)
	case RADIO_TXPOWER_TXPOWER_Pos5dBm:
		return 5;
#endif
#if defined(RADIO_TXPOWER_TXPOWER_Pos4dBm)
	case RADIO_TXPOWER_TXPOWER_Pos4dBm:
		return 4;
#endif
#if defined(RADIO_TXPOWER_TXPOWER_Pos3dBm)
	case RADIO_TXPOWER_TXPOWER_Pos3dBm:
		return 3;
#endif
#if defined(RADIO_TXPOWER_TXPOWER_Pos2dBm)
	case RADIO_TXPOWER_TXPOWER_Pos2dBm:
		return 2;
#endif
#if defined(RADIO_TXPOWER_TXPOWER_Pos1dBm)
	case RADIO_TXPOWER_TXPOWER_Pos1dBm:
		return 1;
#endif
#if defined(RADIO_TXPOWER_TXPOWER_0dBm)
	case RADIO_TXPOWER_TXPOWER_0dBm:
		return 0;
#endif
#if defined(RADIO_TXPOWER_TXPOWER_Neg1dBm)
	case RADIO_TXPOWER_TXPOWER_Neg1dBm:
		return -1;
#endif
#if defined(RADIO_TXPOWER_TXPOWER_Neg2dBm)
	case RADIO_TXPOWER_TXPOWER_Neg2dBm:
		return -2;
#endif
#if defined(RADIO_TXPOWER_TXPOWER_Neg3dBm)
	case RADIO_TXPOWER_TXPOWER_Neg3dBm:
		return -3;
#endif
#if defined(RADIO_TXPOWER_TXPOWER_Neg4dBm)
	case RADIO_TXPOWER_TXPOWER_Neg4dBm:
		return -4;
#endif
#if defined(RADIO_TXPOWER_TXPOWER_Neg5dBm)
	case RADIO_TXPOWER_TXPOWER_Neg5dBm:
		return -5;
#endif
#if defined(RADIO_TXPOWER_TXPOWER_Neg6dBm)
	case RADIO_TXPOWER_TXPOWER_Neg6dBm:
		return -6;
#endif
#if defined(RADIO_TXPOWER_TXPOWER_Neg7dBm)
	case RADIO_TXPOWER_TXPOWER_Neg7dBm:
		return -7;
#endif
#if defined(RADIO_TXPOWER_TXPOWER_Neg8dBm)
	case RADIO_TXPOWER_TXPOWER_Neg8dBm:
		return -8;
#endif
#if defined(RADIO_TXPOWER_TXPOWER_Neg9dBm)
	case RADIO_TXPOWER_TXPOWER_Neg9dBm:
		return -9;
#endif
#if defined(RADIO_TXPOWER_TXPOWER_Neg10dBm)
	case RADIO_TXPOWER_TXPOWER_Neg10dBm:
		return -10;
#endif
#if defined(RADIO_TXPOWER_TXPOWER_Neg12dBm)
	case RADIO_TXPOWER_TXPOWER_Neg12dBm:
		return -12;
#endif
#if defined(RADIO_TXPOWER_TXPOWER_Neg14dBm)
	case RADIO_TXPOWER_TXPOWER_Neg14dBm:
		return -14;
#endif
#if defined(RADIO_TXPOWER_TXPOWER_Neg16dBm)
	case RADIO_TXPOWER_TXPOWER_Neg16dBm:
		return -16;
#endif
#if defined(RADIO_TXPOWER_TXPOWER_Neg18dBm)
	case RADIO_TXPOWER_TXPOWER_Neg18dBm:
		return -18;
#endif
#if defined(RADIO_TXPOWER_TXPOWER_Neg20dBm)
	case RADIO_TXPOWER_TXPOWER_Neg20dBm:
		return -20;
#endif
#if defined(RADIO_TXPOWER_TXPOWER_Neg28dBm)
	case RADIO_TXPOWER_TXPOWER_Neg28dBm:
		return -28;
#endif
#if defined(RADIO_TXPOWER_TXPOWER_Neg40dBm)
	case RADIO_TXPOWER_TXPOWER_Neg40dBm:
		return -40;
#endif
#if defined(RADIO_TXPOWER_TXPOWER_Neg46dBm)
	case RADIO_TXPOWER_TXPOWER_Neg46dBm:
		return -46;
#endif
	default:
		return -128; // ongeldige waarde
	}
}

/**
 * @brief Checks whether a given TX power level in dBm is supported by the hardware.
 *
 * This function evaluates whether a given dBm value corresponds to a valid value
 * defined by the RADIO_TXPOWER register for the current SoC. Not all power levels
 * are available on all Nordic chips.
 *
 * @param dbm Desired TX power level in dBm (e.g., 8, 0, -20).
 * @return true If the value is supported by the RADIO peripheral.
 * @return false If the value is unsupported or invalid for the current hardware.
 */
bool tx_power_supported(int8_t dbm)
{
	switch (dbm) {
#if defined(RADIO_TXPOWER_TXPOWER_Neg100dBm)
	case -100:
		return true;
#endif
#if defined(RADIO_TXPOWER_TXPOWER_Neg70dBm)
	case -70:
		return true;
#endif
#if defined(RADIO_TXPOWER_TXPOWER_Neg46dBm)
	case -46:
		return true;
#endif
	case -40:
		return true;
#if defined(RADIO_TXPOWER_TXPOWER_Neg30dBm)
	case -30:
		return true;
#endif
#if defined(RADIO_TXPOWER_TXPOWER_Neg28dBm)
	case -28:
		return true;
#endif
#if defined(RADIO_TXPOWER_TXPOWER_Neg22dBm)
	case -22:
		return true;
#endif
	case -20:
		return true;
#if defined(RADIO_TXPOWER_TXPOWER_Neg18dBm)
	case -18:
		return true;
#endif
	case -16:
		return true;
#if defined(RADIO_TXPOWER_TXPOWER_Neg14dBm)
	case -14:
		return true;
#endif
	case -12:
		return true;
#if defined(RADIO_TXPOWER_TXPOWER_Neg10dBm)
	case -10:
		return true;
#endif
#if defined(RADIO_TXPOWER_TXPOWER_Neg9dBm)
	case -9:
		return true;
#endif
	case -8:
		return true;
#if defined(RADIO_TXPOWER_TXPOWER_Neg7dBm)
	case -7:
		return true;
#endif
#if defined(RADIO_TXPOWER_TXPOWER_Neg6dBm)
	case -6:
		return true;
#endif
#if defined(RADIO_TXPOWER_TXPOWER_Neg5dBm)
	case -5:
		return true;
#endif
	case -4:
		return true;
#if defined(RADIO_TXPOWER_TXPOWER_Neg3dBm)
	case -3:
		return true;
#endif
#if defined(RADIO_TXPOWER_TXPOWER_Neg2dBm)
	case -2:
		return true;
#endif
#if defined(RADIO_TXPOWER_TXPOWER_Neg1dBm)
	case -1:
		return true;
#endif
	case 0:
		return true;
#if defined(RADIO_TXPOWER_TXPOWER_Pos1dBm)
	case 1:
		return true;
#endif
#if defined(RADIO_TXPOWER_TXPOWER_Pos2dBm)
	case 2:
		return true;
#endif
#if defined(RADIO_TXPOWER_TXPOWER_Pos3dBm)
	case 3:
		return true;
#endif
#if defined(RADIO_TXPOWER_TXPOWER_Pos4dBm)
	case 4:
		return true;
#endif
#if defined(RADIO_TXPOWER_TXPOWER_Pos5dBm)
	case 5:
		return true;
#endif
#if defined(RADIO_TXPOWER_TXPOWER_Pos6dBm)
	case 6:
		return true;
#endif
#if defined(RADIO_TXPOWER_TXPOWER_Pos7dBm)
	case 7:
		return true;
#endif
#if defined(RADIO_TXPOWER_TXPOWER_Pos8dBm)
	case 8:
		return true;
#endif
#if defined(RADIO_TXPOWER_TXPOWER_Pos9dBm)
	case 9:
		return true;
#endif
#if defined(RADIO_TXPOWER_TXPOWER_Pos10dBm)
	case 10:
		return true;
#endif
	default:
		return false;
	}
}

/**
 * @brief Returns the raw value from the RADIO TXPOWER register as-is.
 *
 * This function returns the enum value currently stored in the TXPOWER register,
 * cast to an int8_t. For most Nordic chips, this corresponds directly to the
 * dBm value. However, this function does not perform any validation or mapping.
 *
 * It is useful for debugging or checking the raw register contents.
 *
 * @return int8_t The current TX power register value, typically matching a dBm level.
 */
int8_t get_current_tx_power(void)
{
    nrf_radio_txpower_t raw_power = nrf_radio_txpower_get(NRF_RADIO);
    return (int8_t)raw_power;
}
```

## src/radio_utils.h
```c
#ifndef RADIO_UTILS_H
#define RADIO_UTILS_H

#include <stdint.h>
#include <stdbool.h>

#ifdef __cplusplus
extern "C" {
#endif

/**
 * @brief Gets the currently active TX power setting from the RADIO peripheral.
 *
 * This function returns the TX power that is currently configured in the RADIO peripheral's TXPOWER register.
 * Note that when using the ESB (Enhanced ShockBurst) protocol, calling esb_set_tx_power() does not
 * immediately update the TXPOWER hardware register. Instead, the desired power level is stored internally
 * in the ESB driver and only applied when a transmission is started (e.g., during esb_write_payload()).
 *
 * Therefore, if this function is called immediately after esb_set_tx_power() and before any payload has been
 * transmitted, it may return the *previous* TX power value. To get the actual active TX power, call this
 * function after at least one successful transmission.
 *
 * @return The current TX power in dBm, as set in the RADIO peripheral.
 */
int8_t get_current_tx_power_dbm(void);

/**
 * @brief Checks whether a given TX power level in dBm is supported by the hardware.
 *
 * This function evaluates whether a given dBm value corresponds to a valid value
 * defined by the RADIO_TXPOWER register for the current SoC. Not all power levels
 * are available on all Nordic chips.
 *
 * @param dbm Desired TX power level in dBm (e.g., 8, 0, -20).
 * @return true If the value is supported by the RADIO peripheral.
 * @return false If the value is unsupported or invalid for the current hardware.
 */
bool tx_power_supported(int8_t dbm);


/**
 * @brief Returns the raw value from the RADIO TXPOWER register as-is.
 *
 * This function returns the enum value currently stored in the TXPOWER register,
 * cast to an int8_t. For most Nordic chips, this corresponds directly to the
 * dBm value. However, this function does not perform any validation or mapping.
 *
 * It is useful for debugging or checking the raw register contents.
 *
 * @return int8_t The current TX power register value, typically matching a dBm level.
 */
int8_t get_current_tx_power(void);


#ifdef __cplusplus
}
#endif

#endif // RADIO_UTILS_H
```
